## prj.conf
```kconfig
# Logging
CONFIG_LOG=y
CONFIG_LOG_BACKEND_BM_UARTE=y

# SoftDevice
CONFIG_SOFTDEVICE=y

# Enable RNG
CONFIG_PSA_CRYPTO=y
CONFIG_PSA_WANT_GENERATE_RANDOM=y

# Enable Crypto functionality required by LE Secure Connection
CONFIG_PSA_WANT_ALG_ECDH=y
CONFIG_PSA_WANT_KEY_TYPE_ECC_KEY_PAIR_GENERATE=y
CONFIG_PSA_WANT_KEY_TYPE_ECC_KEY_PAIR_IMPORT=y
CONFIG_PSA_WANT_KEY_TYPE_ECC_KEY_PAIR_EXPORT=y
CONFIG_PSA_WANT_ECC_SECP_R1_256=y
CONFIG_MBEDTLS_PSA_STATIC_KEY_SLOTS=y
CONFIG_MBEDTLS_PSA_KEY_SLOT_COUNT=1

# Advertising library
CONFIG_BLE_ADV=y

# BLE connection parameter
CONFIG_BLE_CONN_PARAMS=y

# Device information service
CONFIG_BLE_DIS=y
CONFIG_BLE_DIS_SERIAL_NUMBER="ABCD"
CONFIG_BLE_DIS_HW_REVISION="hw 54.15.0"
CONFIG_BLE_DIS_FW_REVISION="fw 17.2.0"
CONFIG_BLE_DIS_SW_REVISION="sw 1.0.0"

# Battery service
CONFIG_BLE_BAS=y

# Heart rate service
CONFIG_BLE_HRS=y

# To simulate measurements
CONFIG_SENSORSIM=y
CONFIG_BM_TIMER=y

# Peer Manager
CONFIG_PEER_MANAGER=y
CONFIG_PM_LESC=y
CONFIG_BM_ZMS=y

# Button for deleting bonds
CONFIG_BM_BUTTONS=y
CONFIG_BM_GPIOTE=y

CONFIG_BM_ZMS_LOG_LEVEL_DBG=y
```

## src/main.c
```c
/*
 * Copyright (c) 2024 Nordic Semiconductor ASA
 *
 * SPDX-License-Identifier: LicenseRef-Nordic-5-Clause
 */

#include <ble_gap.h>
#include <nrf_soc.h>
#include <hal/nrf_gpio.h>
#include <bm/softdevice_handler/nrf_sdh.h>
#include <bm/softdevice_handler/nrf_sdh_ble.h>
#include <bm/bluetooth/ble_adv.h>
#include <bm/bluetooth/ble_conn_params.h>
#include <bm/bluetooth/peer_manager/nrf_ble_lesc.h>
#include <bm/bluetooth/peer_manager/peer_manager.h>
#include <bm/bluetooth/peer_manager/peer_manager_handler.h>
#include <bm/bluetooth/services/uuid.h>
#include <bm/bluetooth/services/ble_bas.h>
#include <bm/bluetooth/services/ble_dis.h>
#include <bm/bluetooth/services/ble_hrs.h>
#include <bm/bm_buttons.h>
#include <bm/bm_timer.h>
#include <bm/sensorsim.h>

#include <zephyr/kernel.h>
#include <zephyr/logging/log.h>
#include <zephyr/logging/log_ctrl.h>

#include <board-config.h>

#include <zephyr/storage/flash_map.h>
#include <bm/storage/bm_storage.h>
#include <bm/fs/bm_zms.h>

LOG_MODULE_REGISTER(sample, CONFIG_SAMPLE_BLE_HRS_LOG_LEVEL);

#define CONN_TAG 1

BLE_ADV_DEF(ble_adv); /* BLE advertising instance */
BLE_BAS_DEF(ble_bas); /* BLE battery service instance */
BLE_HRS_DEF(ble_hrs); /* BLE heart rate service instance */

/** Handle of the current connection. */
static uint16_t conn_handle = BLE_CONN_HANDLE_INVALID;

/**
 * Flag for enabling and disabling the registration of new RR interval measurements.
 * The purpose of disabling this is just to test sending HRM without RR interval data.
 */
static bool rr_interval_enabled = true;

static struct sensorsim_state battery_sim_state;
static struct sensorsim_state heart_rate_sim_state;
static struct sensorsim_state rr_interval_sim_state;

static struct bm_timer battery_timer;
static struct bm_timer heart_rate_timer;
static struct bm_timer rr_interval_timer;
static struct bm_timer sensor_contact_timer;

void battery_level_meas_timeout_handler(void *context)
{
	int err;
	uint32_t nrf_err;
	uint32_t battery_level;

	ARG_UNUSED(context);

	err = sensorsim_measure(&battery_sim_state, &battery_level);
	if (err) {
		LOG_ERR("Failed to get battery measurement, err %d", err);
		return;
	}

	nrf_err = ble_bas_battery_level_update(&ble_bas, conn_handle, battery_level);
	if (nrf_err) {
		/* Ignore if not connected, or CCCD not written/configured by peer. */
		if (nrf_err != BLE_ERROR_INVALID_CONN_HANDLE &&
		    nrf_err != NRF_ERROR_INVALID_STATE &&
		    nrf_err != BLE_ERROR_GATTS_SYS_ATTR_MISSING) {
			LOG_ERR("Failed to update battery level, nrf_error %#x", nrf_err);
		}
	}
}

static void heart_rate_meas_timeout_handler(void *context)
{
	static uint32_t cnt;
	int err;
	uint32_t nrf_err;
	uint32_t heart_rate;

	ARG_UNUSED(context);

	err = sensorsim_measure(&heart_rate_sim_state, &heart_rate);
	if (err) {
		LOG_ERR("Failed to get heart rate measurement, err %d", err);
		return;
	}

	nrf_err = ble_hrs_heart_rate_measurement_send(&ble_hrs, (uint16_t)heart_rate);
	if (nrf_err) {
		/* Ignore if not connected, or CCCD not written/configured by peer. */
		if (nrf_err != BLE_ERROR_INVALID_CONN_HANDLE &&
		    nrf_err != NRF_ERROR_INVALID_STATE &&
		    nrf_err != BLE_ERROR_GATTS_SYS_ATTR_MISSING) {
			LOG_ERR("Failed to send heart rate measurement, nrf_error %#x", nrf_err);
		}
	}

	/* Disable RR Interval recording every third heart rate measurement.
	 * NOTE: An application will normally not do this. It is done here just for
	 * testing generation of messages without RR Interval measurements.
	 */
	rr_interval_enabled = ((cnt++ % 3) != 0);
}

static void rr_interval_timeout_handler(void *context)
{
	int err;
	uint32_t nrf_err;
	uint32_t rr_interval;

	ARG_UNUSED(context);

	if (!rr_interval_enabled) {
		return;
	}

	for (int i = 0; i < 3; i++) {
		err = sensorsim_measure(&rr_interval_sim_state, &rr_interval);
		if (err) {
			LOG_ERR("Failed to get RR interval measurement, err %d", err);
			break;
		}

		nrf_err = ble_hrs_rr_interval_add(&ble_hrs, (uint16_t)rr_interval);
		if (nrf_err) {
			LOG_ERR("Failed to add RR interval, nrf_error %#x", nrf_err);
		}
	}
}

static void sensor_contact_detected_timeout_handler(void *context)
{
	static bool sim_sensor_contact_detected;
	uint32_t nrf_err;

	ARG_UNUSED(context);

	sim_sensor_contact_detected = !sim_sensor_contact_detected;
	nrf_err = ble_hrs_sensor_contact_detected_update(&ble_hrs, sim_sensor_contact_detected);
	if (nrf_err) {
		LOG_ERR("Failed to update sensor contact detected state, nrf_error %#x", nrf_err);
	}
}

static void simulated_meas_init(void)
{
	int err;
	const struct sensorsim_cfg battery_sim_cfg = {
		.min = CONFIG_SAMPLE_BATTERY_LEVEL_MIN, .max = CONFIG_SAMPLE_BATTERY_LEVEL_MAX,
		.incr = CONFIG_SAMPLE_BATTERY_LEVEL_INCREMENT, .start_at_max = true,
	};
	const struct sensorsim_cfg heart_rate_sim_cfg = {
		.min = CONFIG_SAMPLE_HEART_RATE_MIN, .max = CONFIG_SAMPLE_HEART_RATE_MAX,
		.incr = CONFIG_SAMPLE_HEART_RATE_INCREMENT, .start_at_max = false,
	};
	const struct sensorsim_cfg rr_interval_sim_cfg = {
		.min = CONFIG_SAMPLE_RR_INTERVAL_MIN, .max = CONFIG_SAMPLE_RR_INTERVAL_MAX,
		.incr = CONFIG_SAMPLE_RR_INTERVAL_INCREMENT, .start_at_max = false,
	};

	err = sensorsim_init(&battery_sim_state, &battery_sim_cfg);
	if (err) {
		LOG_ERR("Failed to initialize battery simulator, err %d", err);
	}
	err = sensorsim_init(&heart_rate_sim_state, &heart_rate_sim_cfg);
	if (err) {
		LOG_ERR("Failed to initialize heart rate simulator, err %d", err);
	}
	err = sensorsim_init(&rr_interval_sim_state, &rr_interval_sim_cfg);
	if (err) {
		LOG_ERR("Failed to initialize RR interval simulator, err %d", err);
	}

	err = bm_timer_init(&battery_timer, BM_TIMER_MODE_REPEATED,
			      battery_level_meas_timeout_handler);
	if (err) {
		LOG_ERR("Failed to initialize battery measurement timer, err %d", err);
	}
	err = bm_timer_init(&heart_rate_timer, BM_TIMER_MODE_REPEATED,
			      heart_rate_meas_timeout_handler);
	if (err) {
		LOG_ERR("Failed to initialize heart rate measurement timer, err %d", err);
	}
	err = bm_timer_init(&rr_interval_timer, BM_TIMER_MODE_REPEATED,
			      rr_interval_timeout_handler);
	if (err) {
		LOG_ERR("Failed to initialize RR interval measurement timer, err %d", err);
	}
	err = bm_timer_init(&sensor_contact_timer, BM_TIMER_MODE_REPEATED,
			      sensor_contact_detected_timeout_handler);
	if (err) {
		LOG_ERR("Failed to initialize sensor contact measurement timer, err %d", err);
	}
}

static void simulated_meas_start(void)
{
	(void)bm_timer_start(&battery_timer,
			     BM_TIMER_MS_TO_TICKS(CONFIG_SAMPLE_BATTERY_LEVEL_MEAS_INTERVAL), NULL);
	(void)bm_timer_start(&heart_rate_timer,
			     BM_TIMER_MS_TO_TICKS(CONFIG_SAMPLE_HEART_RATE_MEAS_INTERVAL), NULL);
	(void)bm_timer_start(&rr_interval_timer,
			     BM_TIMER_MS_TO_TICKS(CONFIG_SAMPLE_RR_INTERVAL_MEAS_INTERVAL), NULL);
	(void)bm_timer_start(&sensor_contact_timer,
			     BM_TIMER_MS_TO_TICKS(CONFIG_SAMPLE_SENSOR_CONTACT_DETECTED_INTERVAL),
			     NULL);
}

static void on_ble_evt(const ble_evt_t *evt, void *ctx)
{
	switch (evt->header.evt_id) {
	case BLE_GAP_EVT_CONNECTED:
		LOG_INF("Peer connected");
		conn_handle = evt->evt.gap_evt.conn_handle;
		nrf_gpio_pin_write(BOARD_PIN_LED_1, BOARD_LED_ACTIVE_STATE);
		break;

	case BLE_GAP_EVT_DISCONNECTED:
		LOG_INF("Peer disconnected");
		if (conn_handle == evt->evt.gap_evt.conn_handle) {
			conn_handle = BLE_CONN_HANDLE_INVALID;
		}
		nrf_gpio_pin_write(BOARD_PIN_LED_1, !BOARD_LED_ACTIVE_STATE);
		break;

	case BLE_GAP_EVT_PASSKEY_DISPLAY:
		LOG_INF("Passkey: %.*s", BLE_GAP_PASSKEY_LEN,
			evt->evt.gap_evt.params.passkey_display.passkey);
		break;
	}
}
NRF_SDH_BLE_OBSERVER(sdh_ble, on_ble_evt, NULL, USER_LOW);

void on_conn_params_evt(const struct ble_conn_params_evt *evt)
{
	uint32_t nrf_err;

	ble_hrs_conn_params_evt(&ble_hrs, evt);

	switch (evt->evt_type) {
	case BLE_CONN_PARAMS_EVT_REJECTED:
		nrf_err = sd_ble_gap_disconnect(evt->conn_handle,
						BLE_HCI_CONN_INTERVAL_UNACCEPTABLE);
		if (nrf_err) {
			LOG_ERR("Disconnect failed on conn params update rejection, nrf_error %#x",
				nrf_err);
		} else {
			LOG_ERR("Disconnected from peer, unacceptable conn params");
		}
		break;

	default:
		break;
	}
}

static void ble_adv_evt_handler(struct ble_adv *adv, const struct ble_adv_evt *adv_evt)
{
	switch (adv_evt->evt_type) {
	case BLE_ADV_EVT_ERROR:
		LOG_ERR("Advertising error %#x", adv_evt->error.reason);
		break;
	default:
		break;
	}
}

static void ble_bas_evt_handler(struct ble_bas *bas, const struct ble_bas_evt *evt)
{
	switch (evt->evt_type) {
	case BLE_BAS_EVT_NOTIFICATION_ENABLED:
		LOG_INF("Battery notifications enabled for connection %#x", evt->conn_handle);
		break;
	case BLE_BAS_EVT_NOTIFICATION_DISABLED:
		LOG_INF("Battery notifications disabled for connection %#x", evt->conn_handle);
		break;
	default:
		break;
	}
}

static void ble_hrs_evt_handler(struct ble_hrs *hrs, const struct ble_hrs_evt *evt)
{
	switch (evt->evt_type) {
	case BLE_HRS_EVT_NOTIFICATION_ENABLED:
		LOG_INF("HRM notifications enabled for connection %#x", evt->conn_handle);
		break;
	case BLE_HRS_EVT_NOTIFICATION_DISABLED:
		LOG_INF("HRM notifications disabled for connection %#x", evt->conn_handle);
		break;
	default:
		break;
	}
}

static struct bm_zms_fs fs;
static volatile bool mount_done;
static volatile bool clear_done;

static void storage_handler(const struct bm_zms_evt *evt)
{
	switch (evt->evt_type) {
	case BM_ZMS_EVT_MOUNT:
		mount_done = true;
		if (evt->result) {
			LOG_ERR("bm_zms_mount failed with error %d", evt->result);
			return;
		}
		break;
	case BM_ZMS_EVT_CLEAR:
		clear_done = true;
		if (evt->result) {
			LOG_ERR("bm_zms_clear failed with error %d", evt->result);
			return;
		}
		break;
	case BM_ZMS_EVT_WRITE:
	case BM_ZMS_EVT_DELETE:
		if (evt->result) {
			LOG_ERR("BM_ZMS Error received %d", evt->result);
		}
		break;
	default:
		LOG_WRN("Unhandled BM_ZMS event ID %u", evt->evt_type);
		break;
	}
}

#define STORAGE_PARTITION_OFFSET PARTITION_ADDRESS(storage0_partition)
#define STORAGE_PARTITION_SIZE PARTITION_SIZE(storage0_partition)
#define STORAGE_SECTOR_SIZE 1024

static int storage_init(void)
{
	int rc;
	struct bm_zms_fs_config config = {
		.offset = STORAGE_PARTITION_OFFSET,
		.sector_size = STORAGE_SECTOR_SIZE,
		.sector_count = (STORAGE_PARTITION_SIZE / STORAGE_SECTOR_SIZE),
		.evt_handler = storage_handler,
		.storage_api = &bm_storage_sd_api,
	};

	mount_done = false;
	clear_done = false;

	rc = bm_zms_mount(&fs, &config);
	if (rc) {
		LOG_ERR("Storage Init failed, rc %d", rc);
		return rc;
	}
	
	while (!mount_done) {
		k_cpu_idle();
	}

	// rc = bm_zms_clear(&fs);
	// if (rc) {
	// 	LOG_ERR("Error while cleaning the storage, rc %d", rc);
	// 	return rc;
	// }
	
	// while(!clear_done) {
	// 	k_cpu_idle();
	// }

	LOG_INF("Storage initialized successfully");
	return 0;
}

#define ENTRY_2_ID 1337
#define ENTRY_31_ID 43
#define ENTRY_32_ID 101

__aligned(4) uint8_t entry_2_data[63] = {0xA0,0xA2,0xA4,0xA6,0xA8,0xAA,0xAC,0xAE,
					  0xB0,0xB2,0xB4,0xB6,0xB8,0xBA,0xBC,0xBE,
					  0xC0,0xC2,0xC4,0xC6,0xC8,0xCA,0xCC,0xCE,
					  0xD0,0xD2,0xD4,0xD6,0xD8,0xDA,0xDC,0xDE,
					  0xA0,0xA2,0xA4,0xA6,0xA8,0xAA,0xAC,0xAE,
					  0xB0,0xB2,0xB4,0xB6,0xB8,0xBA,0xBC,0xBE,
					  0xC0,0xC2,0xC4,0xC6,0xC8,0xCA,0xCC,0xCE,
					  0xD0,0xD2,0xD4,0xD6,0xD8,0xDA,0xDC};

__aligned(4) uint8_t entry_31_data[127] = {0x20,0x22,0x24,0x26,0x28,0x2A,0x2C,0x2E,
					  0x30,0x32,0x34,0x36,0x38,0x3A,0x3C,0x3E,
					  0x40,0x42,0x44,0x46,0x48,0x4A,0x4C,0x4E,
					  0x50,0x52,0x54,0x56,0x58,0x5A,0x5C,0x5E,
					  0x20,0x22,0x24,0x26,0x28,0x2A,0x2C,0x2E,
					  0x30,0x32,0x34,0x36,0x38,0x3A,0x3C,0x3E,
					  0x40,0x42,0x44,0x46,0x48,0x4A,0x4C,0x4E,
					  0x50,0x52,0x54,0x56,0x58,0x5A,0x5C,0x5E,
					  0x20,0x22,0x24,0x26,0x28,0x2A,0x2C,0x2E,
					  0x30,0x32,0x34,0x36,0x38,0x3A,0x3C,0x3E,
					  0x40,0x42,0x44,0x46,0x48,0x4A,0x4C,0x4E,
					  0x50,0x52,0x54,0x56,0x58,0x5A,0x5C,0x5E,
					  0x20,0x22,0x24,0x26,0x28,0x2A,0x2C,0x2E,
					  0x30,0x32,0x34,0x36,0x38,0x3A,0x3C,0x3E,
					  0x40,0x42,0x44,0x46,0x48,0x4A,0x4C,0x4E,
					  0x50,0x52,0x54,0x56,0x58,0x5A,0x5C};

__aligned(4) uint8_t entry_32_data[7] = {0x11,0x22,0x33,0x44,0x55,0x66,0x77};

static void button_2_handler(uint8_t pin, enum bm_buttons_evt_type action)
{
	int rc;

	if (action != BM_BUTTONS_PRESS) {
		return;
	}

	rc = bm_zms_write(&fs, ENTRY_2_ID, entry_2_data, sizeof(entry_2_data));
	if (rc < 0) {
		LOG_ERR("bm_zms_write failed for entry 2, rc %d", rc);
	}
}

static void button_3_handler(uint8_t pin, enum bm_buttons_evt_type action)
{
	int rc;
	static uint32_t entry_id = ENTRY_31_ID;

	if (action != BM_BUTTONS_PRESS) {
		return;
	}

	/* Flip between two different entries. */
	entry_id = (entry_id == ENTRY_31_ID) ? ENTRY_32_ID : ENTRY_31_ID;

	if (entry_id == ENTRY_31_ID) {
		rc = bm_zms_write(&fs, ENTRY_31_ID, entry_31_data, sizeof(entry_31_data));
		if (rc < 0) {
			LOG_ERR("bm_zms_write failed for entry 31, rc %d", rc);
		}
	} else {
		rc = bm_zms_write(&fs, ENTRY_32_ID, entry_32_data, sizeof(entry_32_data));
		if (rc < 0) {
			LOG_ERR("bm_zms_write failed for entry 32, rc %d", rc);
		}
	}
}

static int buttons_init(bool *erase_bonds)
{
	int err;
	static const struct bm_buttons_config cfg[] = {
		{
			.pin_number = BOARD_PIN_BTN_1,
			.active_state = BM_BUTTONS_ACTIVE_LOW,
			.pull_config = BM_BUTTONS_PIN_PULLUP,
			.handler = NULL,
		},
		{
			.pin_number = BOARD_PIN_BTN_2,
			.active_state = BM_BUTTONS_ACTIVE_LOW,
			.pull_config = BM_BUTTONS_PIN_PULLUP,
			.handler = button_2_handler,
		},
		{
			.pin_number = BOARD_PIN_BTN_3,
			.active_state = BM_BUTTONS_ACTIVE_LOW,
			.pull_config = BM_BUTTONS_PIN_PULLUP,
			.handler = button_3_handler,
		},
	};

	err = bm_buttons_init(cfg, ARRAY_SIZE(cfg), BM_BUTTONS_DETECTION_DELAY_MIN_US);
	if (err) {
		return err;
	}

	err = bm_buttons_enable();
	if (err) {
		return err;
	}

	if (erase_bonds != NULL) {
		*erase_bonds = bm_buttons_is_pressed(BOARD_PIN_BTN_1);
	}

	return 0;
}

static void delete_bonds(void)
{
	uint32_t nrf_err;

	LOG_INF("Erase bonds!");

	nrf_err = pm_peers_delete();
	if (nrf_err) {
		LOG_ERR("Failed to delete peers, nrf_error %#x", nrf_err);
	}
}

static void advertising_start(bool erase_bonds)
{
	uint32_t nrf_err;

	if (erase_bonds) {
		delete_bonds();
	} else {
		nrf_err = ble_adv_start(&ble_adv, BLE_ADV_MODE_FAST);
		if (nrf_err) {
			LOG_ERR("Failed to start advertising, nrf_error %#x", nrf_err);
		} else {
			LOG_INF("Advertising as %s", CONFIG_SAMPLE_BLE_DEVICE_NAME);
		}
	}
}

static void pm_evt_handler(const struct pm_evt *p_evt)
{
	pm_handler_on_pm_evt(p_evt);
	pm_handler_disconnect_on_sec_failure(p_evt);
	pm_handler_flash_clean(p_evt);

	switch (p_evt->evt_id) {
	case PM_EVT_PEERS_DELETE_SUCCEEDED:
		advertising_start(false);
		break;
	default:
		break;
	}
}

static uint32_t peer_manager_init(void)
{
	ble_gap_sec_params_t sec_param;
	uint32_t nrf_err;

	nrf_err = pm_init();
	if (nrf_err) {
		return nrf_err;
	}

	memset(&sec_param, 0, sizeof(ble_gap_sec_params_t));

	/* Security parameters to be used for all security procedures. */
	sec_param = (ble_gap_sec_params_t) {
		.bond = 1,
		.mitm = 0,
		.lesc = 1,
		.keypress = 0,
		.io_caps = BLE_GAP_IO_CAPS_DISPLAY_ONLY,
		.oob = 0,
		.min_key_size = 16,
		.max_key_size = 16,
		.kdist_own.enc = 1,
		.kdist_own.id = 1,
		.kdist_peer.enc = 1,
		.kdist_peer.id = 1,
	};

	nrf_err = pm_sec_params_set(&sec_param);
	if (nrf_err) {
		LOG_ERR("pm_sec_params_set() failed, nrf_error %#x", nrf_err);
		return nrf_err;
	}

	nrf_err = pm_register(pm_evt_handler);
	if (nrf_err) {
		LOG_ERR("pm_register() failed, nrf_error %#x", nrf_err);
		return nrf_err;
	}

	return NRF_SUCCESS;
}

int main(void)
{
	int err;
	uint32_t nrf_err;
	bool erase_bonds = false;
	uint8_t body_sensor_location = BLE_HRS_BODY_SENSOR_LOCATION_FINGER;
	ble_gap_conn_sec_mode_t device_name_write_sec;
	ble_uuid_t adv_uuid_list[] = {
		{ .uuid = BLE_UUID_HEART_RATE_SERVICE, .type = BLE_UUID_TYPE_BLE },
	};
	struct ble_adv_config ble_adv_cfg = {
		.conn_cfg_tag = CONFIG_NRF_SDH_BLE_CONN_TAG,
		.evt_handler = ble_adv_evt_handler,
		.adv_data = {
			.name_type = BLE_ADV_DATA_FULL_NAME,
			.flags = BLE_GAP_ADV_FLAGS_LE_ONLY_GENERAL_DISC_MODE,
		},
		.sr_data.uuid_lists.complete = {
			.len = ARRAY_SIZE(adv_uuid_list),
			.uuid = &adv_uuid_list[0],
		},
	};
	struct ble_bas_config bas_cfg = {
		.evt_handler = ble_bas_evt_handler,
		.can_notify = true,
		.battery_level = CONFIG_SAMPLE_BATTERY_LEVEL_MAX,
		.sec_mode = BLE_BAS_CONFIG_SEC_MODE_DEFAULT,
	};
	struct ble_dis_config dis_config = {
		.sec_mode = BLE_DIS_CONFIG_SEC_MODE_DEFAULT,
	};
	struct ble_hrs_config hrs_cfg = {
		.evt_handler = ble_hrs_evt_handler,
		.is_sensor_contact_supported = true,
		.body_sensor_location = &body_sensor_location,
		.sec_mode = BLE_HRS_CONFIG_SEC_MODE_DEFAULT,
	};

	LOG_INF("BLE HRS sample started");

	simulated_meas_init();

	err = nrf_sdh_enable_request();
	if (err) {
		LOG_ERR("Failed to enable SoftDevice, err %d", err);
		goto idle;
	}

	LOG_INF("SoftDevice enabled");

	err = nrf_sdh_ble_enable(CONFIG_NRF_SDH_BLE_CONN_TAG);
	if (err) {
		LOG_ERR("Failed to enable BLE, err %d", err);
		goto idle;
	}

	LOG_INF("Bluetooth enabled");

	BLE_GAP_CONN_SEC_MODE_SET_NO_ACCESS(&device_name_write_sec);
	nrf_err = sd_ble_gap_device_name_set(&device_name_write_sec, CONFIG_SAMPLE_BLE_DEVICE_NAME,
					     strlen(CONFIG_SAMPLE_BLE_DEVICE_NAME));
	if (nrf_err) {
		LOG_ERR("Failed to set device name, nrf_error %#x", nrf_err);
		goto idle;
	}

	nrf_err = peer_manager_init();
	if (nrf_err) {
		LOG_ERR("Failed to initialize Peer Manager, nrf_error %#x", nrf_err);
		goto idle;
	}

	LOG_INF("Peer Manager initialized");

	nrf_err = ble_hrs_init(&ble_hrs, &hrs_cfg);
	if (nrf_err) {
		LOG_ERR("Failed to initialize heart rate service, nrf_error %#x", nrf_err);
		goto idle;
	}

	nrf_err = ble_bas_init(&ble_bas, &bas_cfg);
	if (nrf_err) {
		LOG_ERR("Failed to initialize battery service, nrf_error %#x", nrf_err);
		goto idle;
	}

	nrf_err = ble_dis_init(&dis_config);
	if (nrf_err) {
		LOG_ERR("Failed to initialize device information service, nrf_error %#x", nrf_err);
		goto idle;
	}

	LOG_INF("Services initialized");

	nrf_err = ble_conn_params_evt_handler_set(on_conn_params_evt);
	if (nrf_err) {
		LOG_ERR("Failed to setup conn param event handler, nrf_error %#x", nrf_err);
		goto idle;
	}

	err = buttons_init(&erase_bonds);
	if (err) {
		LOG_ERR("Failed to initialize buttons, err %d", err);
		goto idle;
	}

	nrf_gpio_cfg_output(BOARD_PIN_LED_0);
	nrf_gpio_cfg_output(BOARD_PIN_LED_1);
	nrf_gpio_pin_write(BOARD_PIN_LED_0, !BOARD_LED_ACTIVE_STATE);
	nrf_gpio_pin_write(BOARD_PIN_LED_1, !BOARD_LED_ACTIVE_STATE);

	nrf_err = ble_adv_init(&ble_adv, &ble_adv_cfg);
	if (nrf_err) {
		LOG_ERR("Failed to initialize advertising, nrf_error %#x", nrf_err);
		goto idle;
	}

	nrf_gpio_pin_write(BOARD_PIN_LED_0, BOARD_LED_ACTIVE_STATE);
	LOG_INF("BLE HRS sample initialized");

	// simulated_meas_start();

	// advertising_start(erase_bonds);

	err = storage_init();
	if (err) {
		// LOG_ERR("storage init failed, err %d", err);
	}

idle:
	while (true) {
		(void)nrf_ble_lesc_request_handler();

		log_flush();

		k_cpu_idle();
	}

	return 0;
}
```
